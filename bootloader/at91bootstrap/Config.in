## bootloader/at91bootstrap/Config.in
```kconfig
mainmenu "AT91 Bootstrap configuration"

config HAVE_DOT_CONFIG
	bool
	default y
	help
	  Indicate that have an included file.

source "board/Config.in"

source "driver/Config.in.memory"

config CONFIG_PROJECT
	string
	default "dataflash"	if CONFIG_DATAFLASH
	default "flash"		if CONFIG_FLASH
	default "nandflash"	if CONFIG_NANDFLASH
	default "sdcard"	if CONFIG_SDCARD

choice
	prompt "Load strategy"
	default CONFIG_LOAD_UBOOT

config CONFIG_LOAD_UBOOT
	bool "Load U-Boot into last MBYTE of SDRAM"
	help
	  Use this mode to load an second level boot monitor
	  like U-oot into the last MB of SDRAM.

config CONFIG_LOAD_EXAMPLE
	bool "Load a small example into the start of SDRAM"
	help
	  Use this mode to load an embedded application
	  which can have max 64 kB Size

config CONFIG_LOAD_SMALL_APP
	bool "Load a small application into start of SDRAM"
	help
	  Use this mode to load an embedded application
	  which can have a size of up to 1 MByte

config CONFIG_LOAD_LARGE_APP
	bool "Load a small application into start of SDRAM"
	help
	  Use this mode to load an embedded application
	  which can have a size of up to 4 MByte

endchoice

config CONFIG_IMG_ADDRESS
	string
	default "0x00008000" if CONFIG_FLASH
	default "0x00008400" if CONFIG_DATAFLASH
	default "0x00020000" if CONFIG_NANDFLASH
	default	"0x00000000" if CONFIG_SDCARD
	help

config CONFIG_IMG_SIZE
	string
	default	"0x00040000"	if CONFIG_LOAD_UBOOT
	default	"0x00010000"	if CONFIG_LOAD_EXAMPLE
	default	"0x00100000"	if CONFIG_LOAD_APP
	default	"0x00400000"	if CONFIG_LOAD_LARGE_APP
	help
	  at91bootstrap will copy this amount of data

config CONFIG_JUMP_ADDR
	string
	depends on CONFIG_LOAD_UBOOT
	default "0x73F00000" if CONFIG_AT91CAP9ADK
	default "0x23F00000"
	help

config CONFIG_JUMP_ADDR
	string
	depends on !CONFIG_LOAD_UBOOT
	default "0x70000000" if CONFIG_AT91CAP9ADK
	default "0x20000000"
	help

config CONFIG_APP_CHECK
	bool "Check if application has a valid exception vector table"
	default y
	help
	  Let bootstrap disassemble the first 7 double words
	  and check that all, except the reserved vector
	  contains a jump/branch

config CONFIG_LONG_TEST
	bool "Perform a memory test at startup"
	default n
	help
	  

config CONFIG_DEBUG
	bool "Debug Support"
	default y
	help
	  Output Debug messages

config CONFIG_HW_INIT
	bool "Initialize Hardware"
	default y
	help
	  Initialize Hardware
```

## bootloader/at91bootstrap/board/Config.in
```kconfig
config CONFIG_BOARDNAME
	string "Board Name"
	default "at91sam9260ek"
	help
	  Name of the target

choice
	prompt "Board Type"
	default	CONFIG_AT91SAM9260EK
	help
	  Select which board you want to build for

config	CONFIG_AT91SAM9260EK
	bool "at91sam9260ek"
	select CONFIG_SDRAM
	select ALLOW_DATAFLASH
	select ALLOW_NANDFLASH
	select DATAFLASHCARD_ON_CS0
	help
	  Use the AT91SAM9260EK Development board

config	CONFIG_AT91SAM9261EK
	bool "at91sam9261ek"
	select CONFIG_SDRAM
	select ALLOW_DATAFLASH
	select ALLOW_NANDFLASH
	help
	  Use the AT91SAM9261EK Development board

config	CONFIG_AT91SAM9263EK
	bool "at91sam9263ek"
	select CONFIG_SDRAM
	select ALLOW_DATAFLASH
	select ALLOW_NANDFLASH
	select DATAFLASHCARD_ON_CS0
	help
	  Use the AT91SAM9263EK Development board

config	CONFIG_AT91SAM9RLEK
	bool "at91sam9rlek"
	select ALLOW_DATAFLASH
	select ALLOW_NANDFLASH
	select CONFIG_SDRAM
	help
	  Use the AT91SAM9RLEK Development board

config	CONFIG_AT91SAM9XEEK
	bool "at91sam9xeek"
	select CONFIG_SDRAM
	select ALLOW_DATAFLASH
	select ALLOW_NANDFLASH
	select DATAFLASHCARD_ON_CS0
	help
	  Use the AT91SAM9XEEK Development board

config	CONFIG_AT91SAM9G20EK
	bool "at91sam9g20ek"
	select CONFIG_SDRAM
	select ALLOW_DATAFLASH
	select ALLOW_NANDFLASH
	select DATAFLASHCARD_ON_CS0
	help
	  Use the AT91SAM9G20EK Development board

config	CONFIG_AT91CAP9ADK
	bool "at91cap9adk"
	select CONFIG_SDDRC
	select ALLOW_DATAFLASH
	select ALLOW_FLASH
	select DATAFLASHCARD_ON_CS0
	help
	  Use the AT91CAP9ADK Development board

endchoice

config CONFIG_CHIP
	string
	default "AT91SAM9260"	if CONFIG_AT91SAM9260EK
	default "AT91SAM9261"	if CONFIG_AT91SAM9261EK
	default "AT91SAM9263"	if CONFIG_AT91SAM9263EK
	default "AT91SAM9RL"	if CONFIG_AT91SAM9RLEK
	default "AT91SAM9XE"	if CONFIG_AT91SAM9XEEK
	default "AT91SAM9G20"	if CONFIG_AT91SAM9G20EK
	default "AT91CAP9"	if CONFIG_AT91CAP9ADK
	help
	  Name of the board, A Board Support package
	  (BSP) must be available.

config CONFIG_BOARD
	string
	default "at91sam9260ek"	if CONFIG_AT91SAM9260EK
	default "at91sam9261ek"	if CONFIG_AT91SAM9261EK
	default "at91sam9263ek"	if CONFIG_AT91SAM9263EK
	default "at91sam9rlek"	if CONFIG_AT91SAM9RLEK
	default "at91sam9xeek"	if CONFIG_AT91SAM9XEEK
	default "at91sam9g20ek"	if CONFIG_AT91SAM9G20EK
	default "at91cap9adk"	if CONFIG_AT91CAP9ADK
	help
	  Name of the board, A Board Support package
	  (BSP) must be available.

config CONFIG_MACH_TYPE
	string
	default "0x44B"	if CONFIG_AT91SAM9260EK
	default "0x350"	if CONFIG_AT91SAM9261EK
	default "0x4B2"	if CONFIG_AT91SAM9263EK	
	default "1326"	if CONFIG_AT91SAM9RLEK
	default "0x44B"	if CONFIG_AT91SAM9XEEK
	default "0x658"	if CONFIG_AT91SAM9G20EK
	default "1442"	if CONFIG_AT91CAP9ADK
	help

config CONFIG_LINK_ADDR
	string
	default "0x200000"	if CONFIG_AT91SAM9260EK
	default "0x300000"	if CONFIG_AT91SAM9261EK
	default "0x300000"	if CONFIG_AT91SAM9263EK	
	default "0x300000"	if CONFIG_AT91SAM9RLEK
	default "0x200000"	if CONFIG_AT91SAM9XEEK
	default "0x200000"	if CONFIG_AT91SAM9G20EK
	default "0x000000"	if CONFIG_AT91CAP9ADK	&& CONFIG_DATAFLASH
	default "0x100000"	if CONFIG_AT91CAP9ADK	&& CONFIG_FLASH
	default "0x200000"
	help

config CONFIG_TOP_OF_MEMORY
       string
	default "0x301000"	if CONFIG_AT91SAM9260EK
	default "0x328000"	if CONFIG_AT91SAM9261EK
	default "0x314000"	if CONFIG_AT91SAM9263EK	
	default "0x310000"	if CONFIG_AT91SAM9RLEK
	default "0x301000"	if CONFIG_AT91SAM9XEEK
	default "0x301000"	if CONFIG_AT91SAM9G20EK
	default "0x108000"	if CONFIG_AT91CAP9ADK
	help


choice
	prompt "Bus Speed"
	default CONFIG_BUS_SPEED_133MHZ
	depends on CONFIG_AT91SAM9G20EK
	help
	  Select the speed of the bus

config CONFIG_BUS_SPEED_100MHZ
	bool "100 MHz"
	depends on CONFIG_AT91SAM9G20EK
	help
	  Run the bust at 100 MHz

config CONFIG_BUS_SPEED_133MHZ
	bool "133 MHz"
	depends on CONFIG_AT91SAM9G20EK
	help
	  Run the bust at 133 MHz

endchoice

choice
	prompt "Crystal Frequency"
	default CONFIG_CRYSTAL_18_432MHZ
	help
	  Select the crystal frequency

config CONFIG_CRYSTAL_16_000MHZ
	bool "Build for use of an 16.000 MHz crystal (not yet supported)"
	help
	  Use a 16.000 MHz main crystal frequency

config CONFIG_CRYSTAL_16_36766MHZ
	bool "Build for use of an 16.36766 MHz crystal"
	depends on CONFIG_AT91SAM9263EK
	help
	  Use a 16.36766 MHz main crystal frequency

config CONFIG_CRYSTAL_18_432MHZ
	bool "Build for use of an 18.432 MHz crystal"
	help
	  Use a 18.432 MHz main crystal frequency

endchoice

config CONFIG_CRYSTAL
	string
	default "CRYSTAL_16_000MHZ"	if CONFIG_CRYSTAL_16_000MHZ
	default "CRYSTAL_16_36766MHZ"	if CONFIG_CRYSTAL_16_36766MHZ
	default "CRYSTAL_18_432MHZ"	if CONFIG_CRYSTAL_18_432MHZ
	default "CRYSTAL_18_432MHZ"
	help
	  
	
```
